#include "display.h"
#include "theme.h"
#include "config.h"
#include <Adafruit_GFX.h>
#include <string>
#if defined(DEVICE_RP2350) && !defined(__FREERTOS)
#define __FREERTOS 1
#endif
#include <freertos/FreeRTOS.h>
#include <freertos/semphr.h>
#include <Fonts/FreeSans9pt7b.h>



#if defined(DEVICE_RP2350)

    Adafruit_ST7789 tft = Adafruit_ST7789(&SPI, TFT_CS, TFT_DC, TFT_RST);
    
#else 

    Adafruit_ST7789 tft = Adafruit_ST7789(&SPI, TFT_CS, TFT_DC, TFT_RST);

#endif

int16_t currentCursorY = 0;
int16_t currentCursorX = 5;
bool screenCleared = false;

SemaphoreHandle_t bufferMutex = NULL;

int bufferHead = 0;
int bufferCount = 0;
int scrollOffset = 0;
std::string lineBuffer[SCROLL_BUFFER_SIZE];

void drawWallpaper() {
    tft.fillRect(0, 0, 80, 80, 0xE987);
    // rect 1 copy 1
    tft.fillRect(0, 80, 80, 80, 0x61B0);
    // rect 1 copy 2
    tft.fillRect(0, 160, 80, 80, 0x2E0F);
    // rect 1 copy 3
    tft.fillRect(80, 0, 80, 80, 0xE521);
    // rect 1 copy 4
    tft.fillRect(80, 80, 80, 80, 0x1AF6);
    // rect 1 copy 5
    tft.fillRect(80, 160, 80, 80, 0x63F1);
    // rect 1 copy 6
    tft.fillRect(160, 0, 80, 80, 0xFAA4);
    // rect 1 copy 7
    tft.fillRect(160, 80, 80, 80, 0xCEE7);
    // rect 1 copy 8
    tft.fillRect(160, 160, 80, 80, 0x651D);
    // rect 1 copy 9
    tft.fillRect(240, 0, 80, 80, 0x6225);
    // rect 1 copy 10
    tft.fillRect(240, 80, 80, 80, 0x1B9B);
    // rect 1 copy 11
    tft.fillRect(240, 160, 80, 80, 0xC0E5);
}

void renderScreen(){
    if (bufferMutex != NULL) {
        xSemaphoreTake(bufferMutex, portMAX_DELAY);
    }
    
    Theme current = getCurrentTheme();
    // tft.fillScreen(current.bg);
    drawWallpaper();
    tft.setTextColor(current.fg, current.bg);

    int total = bufferCount;
    int start = total - LINES_ON_SCREEN - scrollOffset;
    if (start < 0) start = 0;

    int y = 0;
    for(int i = start; i < total && i < start + LINES_ON_SCREEN + 1; i++){
        int idx = (bufferHead - total + i + SCROLL_BUFFER_SIZE) % SCROLL_BUFFER_SIZE;
        tft.setCursor(5, y * LINE_HEIGHT);
        tft.println(lineBuffer[idx].c_str());
        y++;
    }

    currentCursorY = y * LINE_HEIGHT;

    if (scrollOffset > 0){
        tft.setTextColor(current.bg , current.bg ^ 0xFFFF);
        tft.setCursor(260, 0);
        char ind[16];
        snprintf(ind, sizeof(ind), "^%d", scrollOffset);
        tft.print(ind);
        vTaskDelay(2 / portTICK_PERIOD_MS);
        tft.endWrite();
        tft.setTextColor(current.fg, current.bg);
        
    }
    
    if (bufferMutex != NULL) {
        xSemaphoreGive(bufferMutex);
    }
}

void scrollUp(int lines){
    if (bufferMutex != NULL) {
        xSemaphoreTake(bufferMutex, portMAX_DELAY);
    }
    
    int oldOffset = scrollOffset;
    int maxScroll = bufferCount - LINES_ON_SCREEN;

    if (maxScroll < 0) maxScroll = 0;

    scrollOffset += lines;

    if (scrollOffset > maxScroll) scrollOffset = maxScroll;
    
    if (bufferMutex != NULL) {
        xSemaphoreGive(bufferMutex);
    }
    
    if (scrollOffset != oldOffset) {
        renderScreen();
    }
}

void scrollDown(int lines){
    if (bufferMutex != NULL) {
        xSemaphoreTake(bufferMutex, portMAX_DELAY);
    }
    
    int oldOffset = scrollOffset;
    scrollOffset -= lines;
    if (scrollOffset < 0) scrollOffset = 0;
    
    if (bufferMutex != NULL) {
        xSemaphoreGive(bufferMutex);
    }
    
    if (scrollOffset != oldOffset) {
        renderScreen();
    }
}

void scrollToBottom(){
    if (bufferMutex != NULL) {
        xSemaphoreTake(bufferMutex, portMAX_DELAY);
    }
    if (0 == scrollOffset) {
        if (bufferMutex != NULL) {
            xSemaphoreGive(bufferMutex);
        }
        return;
    }
    scrollOffset = 0;
    
    if (bufferMutex != NULL) {
        xSemaphoreGive(bufferMutex);
    }
    
    renderScreen();
}

void scrollToTop(){
    if (bufferMutex != NULL) {
        xSemaphoreTake(bufferMutex, portMAX_DELAY);
    }
    
    int maxScroll = bufferCount - LINES_ON_SCREEN;

    if (maxScroll < 0){
      maxScroll = 0;  
    }

    if (maxScroll == scrollOffset) {
        if (bufferMutex != NULL) {
            xSemaphoreGive(bufferMutex);
        }
        return;
    }

    scrollOffset = maxScroll;
    
    if (bufferMutex != NULL) {
        xSemaphoreGive(bufferMutex);
    }
    
    renderScreen();
}

uint8_t sin8(int angle) {
    return (uint8_t)((sin(angle * M_PI / 128.0) + 1.0) * 127.5);
}

void initDisplay() {
    delay(150);
#if defined(DEVICE_RP2350)
    SPI.setTX(TFT_MOSI);
    //SPI.setRX(28);  // Dummy RX pin (GPIO28 - not used)
    SPI.setSCK(TFT_SCLK);
    // SPI.setCS(TFT_CS);
    SPI.begin();
#else
    SPI.begin(TFT_SCLK, -1, TFT_MOSI, TFT_CS);
    SPI.setFrequency(40000000);
#endif
    tft.init(240, 320);
    tft.setRotation(1);
    tft.setTextWrap(true);
    tft.invertDisplay(false);
    for(int i = 0; i < SCROLL_BUFFER_SIZE; ++i){
        lineBuffer[i] = "\n";
    }
    
    if (bufferMutex == NULL) {
        bufferMutex = xSemaphoreCreateMutex();
    }
    applyTheme();
    currentCursorY = 0;
}


void applyTheme() {
    Theme current = getCurrentTheme();
    // tft.fillScreen(current.bg);
    drawWallpaper();
    tft.setTextColor(current.fg);
    tft.setCursor(5, 0);
    currentCursorY = 0;
}

void clearScreen() {
    if (bufferMutex != NULL) {
        xSemaphoreTake(bufferMutex, portMAX_DELAY);
    }
    
    Theme current = getCurrentTheme();
    // tft.fillScreen(current.bg);
    drawWallpaper();
    tft.setCursor(5, 0);
    currentCursorY = 0;
    scrollOffset = 0;
    tft.setTextColor(current.fg, current.bg);
    screenCleared = true;
    // print(">" + getDeviceName() + "@Mini:");
    
    if (bufferMutex != NULL) {
        xSemaphoreGive(bufferMutex);
    }
}

void newPage() {
    Theme current = getCurrentTheme();
    // tft.fillScreen(current.bg);
    drawWallpaper();
    tft.setCursor(5, 0);
    currentCursorY = 0;
    tft.setTextColor(current.fg, current.bg);
}

void printLine(const std::string& s) {
    Serial.println(s.c_str());

    if (bufferMutex != NULL) {
        xSemaphoreTake(bufferMutex, portMAX_DELAY);
    }
    
    lineBuffer[bufferHead] = s;
    bufferHead = (bufferHead + 1) % SCROLL_BUFFER_SIZE;
    if (bufferCount < SCROLL_BUFFER_SIZE) bufferCount++;
    
    bool wasScrolled = (scrollOffset > 0);

    if (bufferMutex != NULL) {
        xSemaphoreGive(bufferMutex);
    }
    
    if (wasScrolled) {
        scrollToBottom();
        return;
    }
    
    if (scrollOffset == 0) {
        Theme current = getCurrentTheme();

        if (currentCursorY + LINE_HEIGHT > MAX_Y) {
            newPage();
            // renderScreen();

            vTaskDelay(1 / portTICK_PERIOD_MS);
            return;
        }

        tft.setCursor(5, currentCursorY);
        tft.setTextColor(current.fg, current.bg);
        tft.println(s.c_str());
        currentCursorY = tft.getCursorY();
        currentCursorX = tft.getCursorX();

        vTaskDelay(1 / portTICK_PERIOD_MS);
    }
}
void printLineNoSerialLineBreak(const std::string& s) {
    Serial.print(s.c_str());

    if (bufferMutex != NULL) {
        xSemaphoreTake(bufferMutex, portMAX_DELAY);
    }
    
    lineBuffer[bufferHead] = s;
    bufferHead = (bufferHead + 1) % SCROLL_BUFFER_SIZE;
    if (bufferCount < SCROLL_BUFFER_SIZE) bufferCount++;
    
    bool wasScrolled = (scrollOffset > 0);

    if (bufferMutex != NULL) {
        xSemaphoreGive(bufferMutex);
    }
    
    if (wasScrolled) {
        scrollToBottom();
        return;
    }
    
    if (scrollOffset == 0) {
        Theme current = getCurrentTheme();

        if (currentCursorY + LINE_HEIGHT > MAX_Y) {
            newPage();
            // renderScreen();

            vTaskDelay(1 / portTICK_PERIOD_MS);
            return;
        }

        tft.setCursor(5, currentCursorY);
        tft.setTextColor(current.fg, current.bg);
        tft.println(s.c_str());
        currentCursorY = tft.getCursorY();
        currentCursorX = tft.getCursorX();

        vTaskDelay(1 / portTICK_PERIOD_MS);
    }
}

void printLineNoBuffer(const std::string& s) {
    Serial.println(s.c_str());

    if (bufferMutex != NULL) {
        xSemaphoreTake(bufferMutex, portMAX_DELAY);
    }
    
    bool wasScrolled = (scrollOffset > 0);
    
    if (bufferMutex != NULL) {
        xSemaphoreGive(bufferMutex);
    }
    
    if (wasScrolled) {
        scrollToBottom();
    }

    if (scrollOffset == 0) {
        Theme current = getCurrentTheme();

        if (currentCursorY + LINE_HEIGHT > MAX_Y) {
            newPage();
            // renderScreen();

            vTaskDelay(1 / portTICK_PERIOD_MS);
            return;
        }

        tft.setCursor(5, currentCursorY);
        tft.setTextColor(current.fg, current.bg);
        tft.println(s.c_str());
        currentCursorY = tft.getCursorY();
        currentCursorX = tft.getCursorX();

        vTaskDelay(1 / portTICK_PERIOD_MS);
    }
}


void print(const std::string& s) {
    Serial.print(s.c_str());

    if (bufferMutex != NULL) {
        xSemaphoreTake(bufferMutex, portMAX_DELAY);
    }
    
    Theme current = getCurrentTheme();
    if (currentCursorY > MAX_Y) {
        newPage();
    }
    tft.setTextColor(current.fg, current.bg);
    tft.print(s.c_str());
    currentCursorY = tft.getCursorY();
    currentCursorX = tft.getCursorX();
    
    if (bufferMutex != NULL) {
        xSemaphoreGive(bufferMutex);
    }
}

void print(const char& s) {
    Serial.print(s);

    if (bufferMutex != NULL) {
        xSemaphoreTake(bufferMutex, portMAX_DELAY);
    }
    
    Theme current = getCurrentTheme();
    if (currentCursorY > MAX_Y) {
        newPage();
    }
    tft.setTextColor(current.fg, current.bg);
    tft.print(s);
    currentCursorY = tft.getCursorY();
    currentCursorX = tft.getCursorX();
    
    if (bufferMutex != NULL) {
        xSemaphoreGive(bufferMutex);
    }
}

void printPrompt(bool serial){
    char triangle[2] = ">";
    char host[5] = "Mini";
    char colon[2] = ":";
    
    if (serial)
    { 
    Serial.print(triangle);
    Serial.print( getDeviceName().c_str());
    Serial.print("@");
    Serial.print(host);
    Serial.print(colon);
    }

    if (bufferMutex != NULL) {
        xSemaphoreTake(bufferMutex, portMAX_DELAY);
    }
    
    Theme current = getCurrentTheme();
    if (currentCursorY > MAX_Y) {
        newPage();
    }
    tft.setTextColor(current.prompt.aux,current.bg);
    tft.print(triangle);
    tft.setTextColor(current.prompt.name,current.bg);
    tft.print(getDeviceName().c_str());
    tft.setTextColor(current.prompt.at,current.bg);
    tft.print("@");
    tft.setTextColor(current.prompt.host,current.bg);
    tft.print(host);
    tft.setTextColor(current.prompt.aux,current.bg);
    tft.print(colon);
    tft.setTextColor(current.fg,current.bg);
    currentCursorY = tft.getCursorY();
    currentCursorX = tft.getCursorX();

    if (bufferMutex != NULL) {
        xSemaphoreGive(bufferMutex);
    }
}



void addToBuffer(const std::string& s) {
    if (bufferMutex != NULL) {
        xSemaphoreTake(bufferMutex, portMAX_DELAY);
    }
    
    lineBuffer[bufferHead] = s;
    bufferHead = (bufferHead + 1) % SCROLL_BUFFER_SIZE;
    if (bufferCount < SCROLL_BUFFER_SIZE) bufferCount++;
    
    if (bufferMutex != NULL) {
        xSemaphoreGive(bufferMutex);
    }
}

void screensaver(int mode) {
    screenLocked = true;
    const int width  = 320;
    const int height = 230;

    tft.fillScreen(ST77XX_BLACK);
    Serial.println("Press ENTER to exit...");

    static uint16_t line[320];

    int offset = 0;
    const int targetFPS  = 20;
    const int frameDelay = 1000 / targetFPS;

    while (true) {
        unsigned long frameStart = millis();

        tft.startWrite();

        for (int y = 0; y < height; y++) {
            for (int x = 0; x < width; x++) {
                uint16_t color = ST77XX_BLACK;

                switch (mode) {
                case 1: {
                    int wave = ((x + y + offset) % 40);
                    int brightness = (wave < 20) ? wave * 12 : (40 - wave) * 12;
                    color = tft.color565(0, brightness, brightness);
                } break;

                case 2: {
                    int pos = (x + offset * 2) % 192;
                    int r = 0, g = 0, b = 0;
                    if (pos < 64) { r = 255 - pos * 4; g = pos * 4; }
                    else if (pos < 128) { g = 255 - (pos-64) * 4; b = (pos-64) * 4; }
                    else { b = 255 - (pos-128) * 4; r = (pos-128) * 4; }
                    color = tft.color565(r, g, b);
                } break;

                case 3: {
                    int dx = abs(x - 160);
                    int dy = abs(y - 115);
                    int maxDist = (dx > dy) ? dx : dy;
                    int ring = (maxDist + offset) % 30;
                    int brightness = (ring < 15) ? ring * 17 : (30 - ring) * 17;
                    color = tft.color565(brightness, 0, 255 - brightness);
                } break;

                case 4: {
                    int gridX = (x + offset) >> 4;
                    int gridY = y >> 4;
                    int pulse = (gridX + gridY + (offset >> 2)) & 31;
                    int brightness = (pulse < 16) ? pulse * 16 : (32 - pulse) * 16;
                    color = tft.color565(brightness * 3, brightness >> 1, brightness << 1);
                } break;

                case 5: {
                    int cellSize = 20;
                    int cx = (x + offset) / cellSize;
                    int cy = y / cellSize;
                    if ((cx + cy) % 2 == 0) {
                        int brightness = ((x + offset) % cellSize) * 12;
                        color = tft.color565(brightness, brightness, 255);
                    }
                } break;

                case 6: {
                    int starSeed = (x * 17 + y * 13) % 1000;
                    if (starSeed < 5) {
                        int twinkle = (offset + starSeed * 7) % 30;
                        int brightness = twinkle < 15 ? twinkle * 17 : (30 - twinkle) * 17;
                        color = tft.color565(brightness, brightness, brightness);
                    }
                } break;

                case 7: {
                    int bar = ((x * offset) % 128);
                    int brightness = (bar < 64) ? bar * 6 : (256 - bar) * 6;
                    color = tft.color565(brightness, brightness >> 1, 0);
                } break;

                case 8: {
                    int cellSize = 10;
                    int cx = (x * offset) / cellSize;
                    int cy = (y + offset)/ cellSize;
                    if ((cx + cy) % 2 == 0) {
                        int brightness = ((x + offset) % cellSize) * 12;
                        color = tft.color565(brightness, brightness, 255);
                    } else if ((cx + cy) % 3 == 0) {
                        int brightness = ((x + offset) % cellSize) * 12;
                        color = tft.color565(brightness+20, brightness+20, 196);
                    }
                } break;

                case 9: {
                    int dx = x - (width / 2);  
                    int dy = y - (height / 2);
                    uint16_t raw = (dx * dx + offset) ^ (dy * dy + offset);
                    color = (raw & 0xF800) | (raw & 0x07E0) | (raw & 0x001F);
                } break;

                default:
                    color = ((x + y + offset) % 60 < 30) ? ST77XX_CYAN : ST77XX_BLUE;
                    break;
                }

                line[x] = color;
            }

            tft.setAddrWindow(0, y, width, 1);
            tft.writePixels(line, width);

            if (y % 10 == 0) {
                tft.endWrite();
                vTaskDelay(1 / portTICK_PERIOD_MS);
                tft.startWrite();
            }
        }

        tft.endWrite();

        if (mode == 2) offset += 4;
        else if (mode == 5 || mode == 7) offset += 3;
        else offset += 2;

        if (offset > 10000) offset = 0;

        tft.setTextColor(ST77XX_WHITE, ST77XX_BLACK);
        tft.setTextSize(1);
        tft.setCursor(5, 230);
        tft.print("Press ENTER to exit...");

        if (Serial.available()) {
            char c = Serial.read();
            if (c == '\n') break;
        }

        unsigned long frameTime = millis() - frameStart;
        if (frameTime < frameDelay)
            vTaskDelay((frameDelay - frameTime) / portTICK_PERIOD_MS);
        else
            vTaskDelay(1 / portTICK_PERIOD_MS);
    }

    applyTheme();
    screenLocked = false;
    clearScreen();
}

void showLogo() {
    printLine("    __  ________   ______  ____  _____");
    printLine("   /  |/  /  _/ | / /  _/ / __ \\/ ___/");
    printLine("  / /|_/ // //  |/ // /  / / / /\\__ \\ ");
    printLine(" / /  / // // /|  // /  / /_/ /___/ / ");
    printLine("/_/  /_/___/_/ |_/___/  \\____//____/  ");
    printLine("");
    printLine(OS_VERSION);
    printLine("Check: https://github.com/VuqarAhadli");
}



static const unsigned char PROGMEM image_Certification2_bits[] = {0xfc,0x7f,0x8f,0xc0,0x00,0x3c,0x00,0x07,0x80,0x00,0x00,0x3f,0x80,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0x00,0x00};

static const unsigned char PROGMEM image_menu_information_sign_bits[] = {0x07,0xc0,0x18,0x30,0x20,0x08,0x43,0x04,0x43,0x04,0x80,0x02,0x83,0x82,0x83,0x02,0x83,0x02,0x83,0x02,0x43,0x04,0x43,0x84,0x20,0x08,0x18,0x30,0x07,0xc0,0x00,0x00};

static const uint16_t PROGMEM image_misios_pixels[] = {0xFFFF,0xFFFF,0xFFFF,0xFFFF,0xFFFF,0xFFFF,0xFFFF,0xFFFF,0xFFFF,0xFFFF,0xFFFF,0xFFFF,0xFFFF,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0xFFFF,0xFFFF};

static const uint16_t PROGMEM image_puffy_pixels[] = {0x0000,0x0000,0x0000,0x0000,0x0000,0x0000,0x0000,0x0000,0x0000,0x0000,0x0000,0x0000,0x0000,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0x0000,0x0000};


void drawScreen() {
    tft.fillScreen(0x0);

    // rect 17
    tft.fillRect(0, 1, 320, 239, 0xFFFF);

    // menu_information_sign
    tft.drawBitmap(4, 215, image_menu_information_sign_bits, 15, 16, 0x20E6);

    // misios
    tft.drawRGBBitmap(88, 60, image_misios_pixels, 144, 120);

    // Certification1
    tft.drawBitmap(4, 150, image_Certification2_bits, 103, 56, 0x0);

    // puffy
    tft.drawRGBBitmap(250, 0, image_puffy_pixels, 70, 60);

    // string 6
    tft.setTextColor(0x0);
    tft.setTextWrap(false);
    tft.setFont(&FreeSans9pt7b);
    tft.setCursor(21, 227);
    tft.println("github.com/VuqarAhadli/MiniOS-ESP");
    screenLocked = true;
    while (true) {
        if (Serial.available()) {
            char c = Serial.read();
            if (c == '\n') {
                tft.setFont(NULL);
                clearScreen();
                screenLocked = false;
                break;
            }
        }
        vTaskDelay(10 / portTICK_PERIOD_MS);
    }

}
